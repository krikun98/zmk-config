/*
 * Copyright (c) 2021 The ZMK Contributors
 *
 * SPDX-License-Identifier: MIT
 */

#include "skean.dtsi"

/ {
  chosen {
    zmk,battery = &vbatt;
  };

  vbatt: vbatt {
    compatible = "zmk,battery-nrf-vddh";
  };
};

&kscan0 {
    col-gpios
        = <&gpio0 10 GPIO_ACTIVE_HIGH>
        , <&gpio0  9 GPIO_ACTIVE_HIGH>
        , <&gpio0 24 GPIO_ACTIVE_HIGH>
        , <&gpio0 13 GPIO_ACTIVE_HIGH>
        , <&gpio0 30 GPIO_ACTIVE_HIGH>
        , <&gpio1  9 GPIO_ACTIVE_HIGH>
        ;
};
