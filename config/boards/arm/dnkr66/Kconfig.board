## config/boards/arm/dnkr66/Kconfig.board
```kconfig
#
# Copyright (c) 2022 The ZMK Contributors
# SPDX-License-Identifier: MIT
#

config BOARD_DNKR66
	bool "dnkr66"
	depends on SOC_NRF52840_QIAA
```

## config/boards/arm/dnkr66/Kconfig.defconfig
```kconfig
# Copyright (c) 2022 The ZMK Contributors
# SPDX-License-Identifier: MIT

if BOARD_DNKR66

config ZMK_KEYBOARD_NAME
	default "DNKR66"

if USB_DEVICE_STACK

config USB_NRFX
	default y

endif # USB_DEVICE_STACK

config BOARD
	default "dnkr66"

config BT_CTLR
	default BT

config ZMK_BLE
	default y

config ZMK_USB
	default y

endif # BOARD_DNKR66
```

## config/boards/arm/jiran_ble_lite/Kconfig.defconfig
```kconfig
#
# Copyright (c) 2021 The ZMK Contributors
# SPDX-License-Identifier: MIT
#

if BOARD_JIRAN_BLE_LITE_LEFT

config ZMK_KEYBOARD_NAME
	default "Jiran BLE Lite"

config ZMK_SPLIT_ROLE_CENTRAL
	default y

endif # BOARD_JIRAN_BLE_LITE_LEFT


if BOARD_JIRAN_BLE_LITE_LEFT || BOARD_JIRAN_BLE_LITE_RIGHT

config BOARD
	default "jiran_ble_lite"

config ZMK_SPLIT
	default y

config BT_CTLR
	default BT

config ZMK_BLE
	default y

config ZMK_USB
	default y

if USB_DEVICE_STACK

config USB_NRFX
	default y

endif # USB_DEVICE_STACK

endif # BOARD_JIRAN_BLE_LITE_LEFT || BOARD_JIRAN_BLE_LITE_RIGHT
```

## config/boards/arm/jorian840/Kconfig.board
```kconfig
# Jorian840 board configuration

# Copyright (c) 2021 The ZMK Contributors
# SPDX-License-Identifier: MIT

config BOARD_JORIAN840_LEFT
	bool "jorian840_left"
	depends on SOC_NRF52840_QIAA

config BOARD_JORIAN840_RIGHT
	bool "jorian840_right"
	depends on SOC_NRF52840_QIAA
```

## config/boards/arm/jorian840/Kconfig.defconfig
```kconfig
#
# Copyright (c) 2021 The ZMK Contributors
# SPDX-License-Identifier: MIT
#

if BOARD_JORIAN840_LEFT

config ZMK_KEYBOARD_NAME
	default "Jorian840"

config ZMK_SPLIT_ROLE_CENTRAL
	default y

endif # BOARD_JORIAN840_LEFT


if BOARD_JORIAN840_LEFT || BOARD_JORIAN840_RIGHT

config BOARD
	default "jorian840"

config ZMK_SPLIT
	default y

config BT_CTLR
	default BT

config ZMK_BLE
	default y

config ZMK_USB
	default y

if USB_DEVICE_STACK

config USB_NRFX
	default y

endif # USB_DEVICE_STACK

endif # BOARD_JORIAN840_LEFT || BOARD_JORIAN840_RIGHT
```

## config/boards/arm/skean/Kconfig.board
```kconfig
# Skean board configuration

# Copyright (c) 2021 The ZMK Contributors
# SPDX-License-Identifier: MIT

config BOARD_SKEAN_LEFT
	bool "skean_left"
	depends on SOC_NRF52833_QIAA

config BOARD_SKEAN_RIGHT
	bool "skean_right"
	depends on SOC_NRF52833_QIAA
```

## config/boards/arm/skean/Kconfig.defconfig
```kconfig
#
# Copyright (c) 2021 The ZMK Contributors
# SPDX-License-Identifier: MIT
#

if BOARD_SKEAN_LEFT

config ZMK_KEYBOARD_NAME
	default "Skean"

config ZMK_SPLIT_ROLE_CENTRAL
	default y

endif # BOARD_SKEAN_LEFT


if BOARD_SKEAN_LEFT || BOARD_SKEAN_RIGHT

config BOARD
	default "skean"

config ZMK_SPLIT
	default y

config BT_CTLR
	default BT

if USB_DEVICE_STACK

config USB_NRFX
	default y

endif # USB_DEVICE_STACK

endif # BOARD_SKEAN_LEFT || BOARD_SKEAN_RIGHT
```

## config/boards/arm/skean/skean_left_defconfig
```kconfig
#
# Copyright (c) 2021 The ZMK Contributors
# SPDX-License-Identifier: MIT
#

CONFIG_SOC_SERIES_NRF52X=y
CONFIG_SOC_NRF52833_QIAA=y
CONFIG_BOARD_SKEAN_LEFT=y
CONFIG_ZMK_SLEEP=y

# Enable MPU
CONFIG_ARM_MPU=y

# Enable GPIO
CONFIG_GPIO=y

# Enable writing to flash
CONFIG_USE_DT_CODE_PARTITION=y
CONFIG_BUILD_OUTPUT_UF2=y
CONFIG_MPU_ALLOW_FLASH_WRITE=y
CONFIG_NVS=y
CONFIG_SETTINGS_NVS=y
CONFIG_FLASH=y
CONFIG_FLASH_PAGE_LAYOUT=y
CONFIG_FLASH_MAP=y

# Set crystal clock speed
CONFIG_CLOCK_CONTROL_NRF_K32SRC_100PPM=y
```

## config/boards/arm/timber/Kconfig.board
```kconfig
# Copyright (c) 2022 The ZMK Contributors
# SPDX-License-Identifier: MIT

config BOARD_TIMBER
	bool "Timber"
	depends on SOC_NRF52840_QIAA
```

## config/boards/arm/timber/Kconfig.defconfig
```kconfig
# Copyright (c) 2022 The ZMK Contributors
# SPDX-License-Identifier: MIT

if BOARD_TIMBER

config ZMK_KEYBOARD_NAME
	default "Timber"

if USB_DEVICE_STACK

config USB_NRFX
	default y

endif # USB_DEVICE_STACK

config BT_CTLR
	default BT

config ZMK_BLE
	default y

config ZMK_USB
	default y

endif # BOARD_TIMBER
```

## config/boards/arm/wenki44/Kconfig.board
```kconfig
# wEnki44 board configuration

# Copyright (c) 2021 The ZMK Contributors
# SPDX-License-Identifier: MIT

config BOARD_WENKI44_LEFT
	bool "wenki44_left"
	depends on SOC_NRF52840_QIAA

config BOARD_WENKI44_RIGHT
	bool "wenki44_right"
	depends on SOC_NRF52840_QIAA
```

## config/boards/arm/wenki44/Kconfig.defconfig
```kconfig
# Copyright (c) 2021 The ZMK Contributors
# SPDX-License-Identifier: MIT

if BOARD_WENKI44_LEFT

	config ZMK_KEYBOARD_NAME
	default "wEnki44"

endif # BOARD_WENKI44_LEFT


if BOARD_WENKI44_LEFT || BOARD_WENKI44_RIGHT

config BOARD
	default "wenki44"

config ZMK_SPLIT
	default y

menuconfig SENSOR
    bool "Sensor Drivers"

config BT_CTLR
	default BT

config ZMK_BLE
	default y

config ZMK_USB
	default y

config ZMK_BATTERY_VOLTAGE_DIVIDER
	default y

if USB

config USB_NRFX
	default y

config USB_DEVICE_STACK
	default y

endif # USB

endif # BOARD_WENKI44_LEFT || BOARD_WENKI44_RIGHT
```

## config/boards/shields/ergo42/Kconfig.defconfig
```kconfig
if SHIELD_ERGO42_LEFT

config ZMK_KEYBOARD_NAME
	default "Ergo42"

config ZMK_SPLIT_BLE_ROLE_CENTRAL
	default y

endif

if SHIELD_ERGO42_LEFT || SHIELD_ERGO42_RIGHT

config ZMK_SPLIT
	default y

endif
```

## config/boards/shields/ergo42/Kconfig.shield
```kconfig
# Copyright (c) 2020 The ZMK Contributors
# SPDX-License-Identifier: MIT

config SHIELD_ERGO42_LEFT
	def_bool $(shields_list_contains,ergo42_left)

config SHIELD_ERGO42_RIGHT
	def_bool $(shields_list_contains,ergo42_right)
```

## config/boards/shields/jian_ns/Kconfig.defconfig
```kconfig
# Copyright (c) 2020 The ZMK Contributors
# SPDX-License-Identifier: MIT

if SHIELD_JIAN_NS

config ZMK_KEYBOARD_NAME
    default "Jian"

endif
```

## config/boards/shields/manuform/Kconfig.defconfig
```kconfig
if SHIELD_MANUFORM_LEFT

config ZMK_KEYBOARD_NAME
	default "Manuform"

config ZMK_SPLIT_BLE_ROLE_CENTRAL
	default y

endif


if SHIELD_MANUFORM_RIGHT

config ZMK_KEYBOARD_NAME
	default "Manuform Right"
	
endif

if SHIELD_MANUFORM_LEFT || SHIELD_MANUFORM_RIGHT

config ZMK_SPLIT
	default y

endif
```

## config/boards/shields/manuform/Kconfig.shield
```kconfig
# Copyright (c) 2021 The ZMK Contributors
# SPDX-License-Identifier: MIT

config SHIELD_MANUFORM_LEFT
	def_bool $(shields_list_contains,manuform_left)

config SHIELD_MANUFORM_RIGHT
	def_bool $(shields_list_contains,manuform_right)
```

## config/boards/shields/pinky3/Kconfig.defconfig
```kconfig
if SHIELD_PINKY3_LEFT

config ZMK_KEYBOARD_NAME
	default "Pinky3"

config ZMK_SPLIT_BLE_ROLE_CENTRAL
	default y

endif

if SHIELD_PINKY3_LEFT || SHIELD_PINKY3_RIGHT

config ZMK_SPLIT
	default y

endif
```

## config/boards/shields/pinky3/Kconfig.shield
```kconfig
# Copyright (c) 2020 The ZMK Contributors
# SPDX-License-Identifier: MIT

config SHIELD_PINKY3_LEFT
	def_bool $(shields_list_contains,pinky3_left)

config SHIELD_PINKY3_RIGHT
	def_bool $(shields_list_contains,pinky3_right)
```

## config/boards/shields/radpad/Kconfig.defconfig
```kconfig
# Copyright (c) 2020 The ZMK Contributors
# SPDX-License-Identifier: MIT

if SHIELD_RADPAD

config ZMK_KEYBOARD_NAME
    default "Radpad"

endif
```

## config/boards/shields/radpad/Kconfig.shield
```kconfig
# Copyright (c) 2020 The ZMK Contributors
# SPDX-License-Identifier: MIT

config SHIELD_RADPAD
	def_bool $(shields_list_contains,radpad)
```

## config/boards/shields/rt-22/Kconfig.defconfig
```kconfig
if SHIELD_RT-22_LEFT

config ZMK_KEYBOARD_NAME
	default "RT-22"

config ZMK_SPLIT_BLE_ROLE_CENTRAL
	default y

endif

if SHIELD_RT-22_LEFT || SHIELD_RT-22_RIGHT

config ZMK_SPLIT
	default y

endif
```

## config/boards/shields/rt-22/Kconfig.shield
```kconfig
# Copyright (c) 2021 The ZMK Contributors
# SPDX-License-Identifier: MIT

config SHIELD_RT-22_LEFT
	def_bool $(shields_list_contains,rt-22_left)

config SHIELD_RT-22_RIGHT
	def_bool $(shields_list_contains,rt-22_right)
```

## config/west.yml
```yaml
manifest:
  remotes:
    - name: zmkfirmware
      url-base: https://github.com/zmkfirmware
    - name: krikun98
      url-base: https://github.com/krikun98
    - name: ergonautkb
      url-base: https://github.com/ergonautkb
  projects:
    - name: zmk
      remote: zmkfirmware
      revision: main
      import: app/west.yml
    - name: skean-zmk-module
      remote: krikun98
      revision: main
    - name: jorian840-zmk-module
      remote: krikun98
      revision: main
    - name: ergonautkb-zmk-module
      remote: ergonautkb
      revision: main
    - name: tbk-mini-zmk-module
      remote: krikun98
      revision: main
  self:
    path: config
```
